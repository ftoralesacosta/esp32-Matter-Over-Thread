## main/Kconfig.projbuild
```kconfig
menu "Example Configuration"
    visible if CUSTOM_COMMISSIONABLE_DATA_PROVIDER

    config DYNAMIC_PASSCODE_COMMISSIONABLE_DATA_PROVIDER
        bool "Enable Dynamic Passcode Commissionable Data Provider"
        depends on CUSTOM_COMMISSIONABLE_DATA_PROVIDER
        default y

    config DYNAMIC_PASSCODE_PROVIDER_DISCRIMINATOR
        int "Discriminator in Dynamic Passcode Commissionable Data Provider"
        depends on DYNAMIC_PASSCODE_COMMISSIONABLE_DATA_PROVIDER
        default 3840
        range 0 4095
        help
            Fixed discriminator in custom dynamic passcode commissionable data provider

    config DYNAMIC_PASSCODE_PROVIDER_ITERATIONS
        int "Iterations in Dynamic Passcode Commissionable Data Provider"
        depends on DYNAMIC_PASSCODE_COMMISSIONABLE_DATA_PROVIDER
        default 10000
        range 1000 100000
        help
            Fixed iterations in custom dynamic passcode commissionable data provider

    config DYNAMIC_PASSCODE_PROVIDER_SALT_BASE64
        string "Base64-Encoded Salt in Dynamic Passcode Commissionable Data Provider"
        depends on DYNAMIC_PASSCODE_COMMISSIONABLE_DATA_PROVIDER
        default "0NHS09TV1tfY2drb3N3e36ChoqOkpaanqKmqq6ytrq8="
        help
            Fixed salt in custom dynamic passcode commissionable data provider. It should be a Base64-Encoded string.

endmenu

menu "Fan Controller Configuration"

    config ENABLE_ROTARY_ENCODER
        bool "Enable rotary encoder dial support"
        default n
        help
            Enable if a rotary encoder module is physically wired to the
            board for local fan speed control (see README for wiring).
            Each detent adjusts the FanControl PercentSetting attribute
            through the same code path a HomeKit write uses, so the dial
            and HomeKit always agree on the current speed.

            Disabled by default: this reserves the encoder A/B GPIOs as
            inputs when enabled, so leave it off until you have the
            hardware wired up. Adds about 6KB to the compiled binary when
            enabled; negligible RAM/CPU otherwise. Safe to leave enabled
            with no encoder physically connected - the pins simply idle via
            internal pull-ups - but there is no reason to if you are not
            using one.

endmenu
```
